## nemu/Kconfig
```kconfig
mainmenu "NEMU Configuration Menu"

choice
  prompt "Base ISA"
  default ISA_riscv32
config ISA_x86
  bool "x86"
config ISA_mips32
  bool "mips32"
config ISA_riscv32
  bool "riscv32"
config ISA_riscv64
  bool "riscv64"
endchoice

config ISA
  string
  default "x86" if ISA_x86
  default "mips32" if ISA_mips32
  default "riscv32" if ISA_riscv32
  default "riscv64" if ISA_riscv64
  default "none"

config ISA64
  depends on ISA_riscv64
  bool
  default y


choice
  prompt "NEMU execution engine"
  default ENGINE_INTERPRETER

config ENGINE_INTERPRETER
  bool "Interpreter"
  help
    Interpreter guest instructions one by one.
endchoice

config ENGINE
  string
  default "interpreter" if ENGINE_INTERPRETER
  default "none"

choice
  prompt "Running mode"
  default MODE_SYSTEM

config MODE_SYSTEM
  bool "System mode"
  help
    Support full-system functionality, including privileged instructions, MMU and devices.
endchoice

choice
  prompt "Build target"
  default TARGET_NATIVE_ELF
config TARGET_NATIVE_ELF
  bool "Executable on Linux Native"
config TARGET_AM
  bool "Application on Abstract-Machine"
endchoice

menu "Build Options"
choice
  prompt "Compiler"
  default CC_GCC
config CC_GCC
  bool "gcc"
config CC_GPP
  bool "g++"
config CC_CLANG
  depends on !TARGET_AM
  bool "clang"
endchoice

config CC
  string
  default "gcc" if CC_GCC
  default "g++" if CC_GPP
  default "clang" if CC_CLANG
  default "none"

choice
  prompt "Optimization Level"
  default CC_O2
config CC_O0
  bool "O0"
config CC_O1
  bool "O1"
config CC_O2
  bool "O2"
config CC_O3
  bool "O3"
endchoice

config CC_OPT
  string
  default "-O0" if CC_O0
  default "-O1" if CC_O1
  default "-O2" if CC_O2
  default "-O3" if CC_O3
  default CC_O3

config CC_LTO
  depends on !TARGET_AM
  bool "Enable link-time optimization"
  default n

config CC_DEBUG
  bool "Enable debug information"
  default n

config CC_AM_DEBUG
  bool "Enable debug information in AM"
  default n

config CC_ASAN
  depends on MODE_SYSTEM
  bool "Enable address sanitizer"
  default n
endmenu

menu "Testing and Debugging"


config TRACE
  bool "Enable tracer"
  default n

config TRACE_START
  depends on TRACE
  int "When tracing is enabled (unit: number of instructions)"
  default 0

config TRACE_END
  depends on TRACE
  int "When tracing is disabled (unit: number of instructions)"
  default 10000

config ITRACE
  depends on TRACE && TARGET_NATIVE_ELF && ENGINE_INTERPRETER
  bool "Enable instruction tracer"
  default n

config ITRACE_COND
  depends on ITRACE
  string "Only trace instructions when the condition is true"
  default "true"


config EXT_PRINT_JUMP
  bool "Jump TRACE"
  default n

config EXT_PRINT_JUMP_MORE
  bool "Jump TRACE disp every jump"
  default n


config DIFFTEST
  depends on TARGET_NATIVE_ELF
  bool "Enable differential testing"
  default n
  help
    Enable differential testing with a reference design.
    Note that this will significantly reduce the performance of NEMU.

choice
  prompt "Reference design"
  default DIFFTEST_REF_SPIKE if ISA_riscv64 || ISA_riscv32
  default DIFFTEST_REF_KVM if ISA_x86
  default DIFFTEST_REF_QEMU
  depends on DIFFTEST
config DIFFTEST_REF_QEMU
  bool "QEMU, communicate with socket"
if ISA_riscv64 || ISA_riscv32
config DIFFTEST_REF_SPIKE
  bool "Spike"
endif
if ISA_x86
config DIFFTEST_REF_KVM
  bool "KVM"
endif
endchoice

config DIFFTEST_REF_PATH
  string
  default "tools/qemu-diff" if DIFFTEST_REF_QEMU
  default "tools/kvm-diff" if DIFFTEST_REF_KVM
  default "tools/spike-diff" if DIFFTEST_REF_SPIKE
  default "none"

config DIFFTEST_REF_NAME
  string
  default "qemu" if DIFFTEST_REF_QEMU
  default "kvm" if DIFFTEST_REF_KVM
  default "spike" if DIFFTEST_REF_SPIKE
  default "none"
endmenu

if MODE_SYSTEM
source "src/memory/Kconfig"
source "src/device/Kconfig"
endif


menu "Miscellaneous"
choice
  depends on !TARGET_AM
  prompt "Host timer"
  default TIMER_GETTIMEOFDAY
config TIMER_GETTIMEOFDAY
  bool "gettimeofday"
config TIMER_CLOCK_GETTIME
  bool "clock_gettime"
endchoice

config RT_CHECK
  bool "Enable runtime checking"
  default y

endmenu

menu "Extensions"
comment "Added by Chiro"
config EXT_RUN_CONFIG_FILE
  string "Default config file to read when no args provided"
  default ".nemu_run_args"
config EXT_PRINT_SECTIONS
  bool "Load & print section info"
  default n
config EXT_PRINT_LOADSAVE
  bool "Print load & save"
  default n
config EXT_PRINT_ARGS
  bool "Print launch args"
  default n
config EXT_PRINT_MAKE_CMDS
  bool "Print cmdlines called by Make"
  default y
config EXT_CC_AM_OPT
  string "CC Option for AM"
  default "O3"
config EXT_RISCV_CROSS
  string "Cross compile tool for riscv"
  default "riscv32-unknown-elf-"
config EXT_DEBUG_QEMU_PORT
  int "run QEMU gdb port"
  default 3333
config EXT_VGA_ALWAYS_REFRESH
  bool "VGA display at any cycle"
  default n
config EXT_VGA_COPY_BY_BYTE
  bool "Copy vmem by byte"
  default n
config EXT_ALL_WARNINGS_AS_ERRORS
  bool "Treat all warnings as errors"
  default n
config EXT_NEWLIB_PATH
  string "Specific newlib installation path"
  default "/home/chiro/Downloads/newlib-3.2.0/build/install/riscv32-unknown-elf"
config EXT_COMPILE_VERBOSE
  bool "--verbose"
  default n
endmenu
```
